## Kconfig
```kconfig
config BLE_PROFILE_LED
	bool "Flash an LED with the active Bluetooth profile"
	default y
	depends on ZMK_BLE && $(dt_nodelabel_enabled,blue_led)
	help
	  Flash the board's blue_led (profile index + 1) times when the active
	  Bluetooth profile changes: 1 flash for profile 0, 2 for profile 1, etc.
	  Selecting the profile that is already active does not flash, because
	  ZMK raises no event for it. Needs a blue_led node in the board's
	  devicetree; without one this option is hidden.

if BLE_PROFILE_LED

config BLE_PROFILE_LED_FLASH_MS
	int "Duration of each flash and each gap between flashes, in ms"
	range 20 1000
	default 150

config BLE_PROFILE_LED_BOOT_TEST
	bool "Flash the LED 3 times at boot"
	help
	  Confirms which physical LED blue_led drives. A profile flash requested
	  during the test waits until it has finished. Leave off once the LED is
	  known, since it also runs on every wake from deep sleep.

endif # BLE_PROFILE_LED
```
