## Kconfig
```kconfig
config BLE_PROFILE_LED
	bool "Flash an LED with the active Bluetooth profile"
	default y
	depends on ZMK_BLE && $(dt_nodelabel_enabled,blue_led)
	help
	  Flash the board's blue_led (profile index + 1) times when the active
	  Bluetooth profile changes: 1 flash for profile 0, 2 for profile 1, etc.
	  Selecting the profile that is already active does not flash, because
	  ZMK raises no event for it. Needs a blue_led node in the board's
	  devicetree; without one this option is hidden.

if BLE_PROFILE_LED

config BLE_PROFILE_LED_FLASH_MS
	int "Duration of each flash and each gap between flashes, in ms"
	range 20 1000
	default 150

config BLE_PROFILE_LED_BOOT_FLASH
	bool "Flash the LED once, for a long time, at boot"
	default y
	help
	  Holds the LED on for BLE_PROFILE_LED_BOOT_MS at every boot, which includes
	  a sys reset and a wake from deep sleep, so you can tell the keyboard has
	  turned on. It is one long flash, which looks nothing like the short
	  profile flashes. A profile flash requested during it waits until it ends.

config BLE_PROFILE_LED_BOOT_MS
	int "How long the boot flash stays on, in ms"
	depends on BLE_PROFILE_LED_BOOT_FLASH
	range 100 3000
	default 1000

endif # BLE_PROFILE_LED
```
