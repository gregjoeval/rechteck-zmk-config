/*
 * Notes on the Rechteck board file (boardsource/Rechtek-zmk-config, bs_lp_60.dts).
 *
 * Battery sense: the board's vbatt node senses the battery on AIN7 (P0.31), which is
 * also the ext-power control pin, so it reads ~0.4 V and ZMK reports 0%. The battery is
 * actually on AIN2 (P0.04); verified on hardware (~3.0 V at the pin, 100% when fully
 * charged). The divider values from the board file are left as-is.
 *
 * ext-power (P0.31): the board file defines it (zmk,ext-power-generic), but what it
 * controls is unknown. A temporary test macro (since removed) switched it off for 5 s
 * and produced no observed change, including to the yellow power LED, which is probably
 * hardwired to the supply or charger. Not confirmed with Boardsource, so don't rely on
 * this pin for anything.
 */
/ {
	vbatt {
		io-channels = <&adc 2>;
	};
};
